## smartscore_s3_audio/sdkconfig.defaults
```kconfig
CONFIG_IDF_TARGET="esp32s3"
CONFIG_ESP_DEFAULT_CPU_FREQ_MHZ_240=y
CONFIG_ESP_DEFAULT_CPU_FREQ_MHZ=240
CONFIG_COMPILER_OPTIMIZATION_PERF=y
CONFIG_COMPILER_OPTIMIZATION_ASSERTIONS_SILENT=y
CONFIG_FREERTOS_HZ=1000
CONFIG_ESP_MAIN_TASK_STACK_SIZE=4096
CONFIG_ESP_SYSTEM_EVENT_TASK_STACK_SIZE=3072
CONFIG_ESP_CONSOLE_UART_BAUDRATE=115200
CONFIG_LOG_DEFAULT_LEVEL_INFO=y
CONFIG_DSP_MAX_FFT_SIZE=4096
CONFIG_SPIRAM=y
CONFIG_SPIRAM_MODE_OCT=y
CONFIG_SPIRAM_TYPE_AUTO=y
CONFIG_SPIRAM_SPEED_80M=y
CONFIG_SPIRAM_BOOT_HW_INIT=y
CONFIG_SPIRAM_BOOT_INIT=y
CONFIG_SPIRAM_USE_CAPS_ALLOC=y
CONFIG_SPIRAM_MEMTEST=y
CONFIG_COMPILER_STACK_CHECK_MODE_NORM=y
CONFIG_FREERTOS_WATCHPOINT_END_OF_STACK=y
```

## smartscore_s3_vision/sdkconfig.defaults
```kconfig
CONFIG_IDF_TARGET="esp32s3"
CONFIG_ESPTOOLPY_FLASHSIZE_16MB=y
CONFIG_ESPTOOLPY_FLASHSIZE="16MB"
CONFIG_PARTITION_TABLE_CUSTOM=y
CONFIG_PARTITION_TABLE_CUSTOM_FILENAME="partitions.csv"
CONFIG_PARTITION_TABLE_FILENAME="partitions.csv"

CONFIG_SPIRAM=y
CONFIG_SPIRAM_MODE_OCT=y
CONFIG_SPIRAM_SPEED_80M=y
CONFIG_SPIRAM_USE_MALLOC=y
CONFIG_SPIRAM_MALLOC_ALWAYSINTERNAL=16384
CONFIG_SPIRAM_MALLOC_RESERVE_INTERNAL=32768

# CONFIG_COMPILER_OPTIMIZATION_SIZE is not set
CONFIG_COMPILER_OPTIMIZATION_PERF=y
CONFIG_ESP_DEFAULT_CPU_FREQ_MHZ_240=y
CONFIG_ESP_DEFAULT_CPU_FREQ_MHZ=240
CONFIG_FREERTOS_HZ=1000
CONFIG_ESP_MAIN_TASK_STACK_SIZE=8192

CONFIG_HAND_DETECT_MODEL_IN_FLASH_PARTITION=y
CONFIG_FLASH_ESPDET_PICO_224_224_HAND=y
CONFIG_ESPDET_PICO_224_224_HAND=y
CONFIG_HAND_GESTURE_CLS_MODEL_IN_FLASH_PARTITION=y
CONFIG_FLASH_HAND_GESTURE_CLS_MOBILENETV2_0_5_S8_V1=y
CONFIG_HAND_GESTURE_CLS_MOBILENETV2_0_5_S8_V1=y
```

## smartscore_s3_voice/main/Kconfig.projbuild
```kconfig
menu "SmartScore Qwen Audio Realtime on voice S3"

    config SMARTSCORE_QWEN_REALTIME_ENABLED
        bool "Enable Qwen Audio Realtime on the voice S3"
        default y

    config SMARTSCORE_QWEN_REALTIME_MODEL
        string "Qwen realtime model"
        default "qwen-audio-3.0-realtime-plus"
        depends on SMARTSCORE_QWEN_REALTIME_ENABLED

    config SMARTSCORE_QWEN_REALTIME_ENDPOINT
        string "Qwen realtime WebSocket endpoint"
        default "wss://dashscope.aliyuncs.com/api-ws/v1/realtime"
        depends on SMARTSCORE_QWEN_REALTIME_ENABLED

    config SMARTSCORE_QWEN_REALTIME_VOICE
        string "Qwen output voice"
        default "longanqian"
        depends on SMARTSCORE_QWEN_REALTIME_ENABLED

    config SMARTSCORE_QWEN_REALTIME_INSTRUCTIONS
        string "Qwen system instructions"
        default "You are the SmartScore piano voice assistant. Answer naturally and concisely in Chinese. The wake phrase is not part of the question."
        depends on SMARTSCORE_QWEN_REALTIME_ENABLED

endmenu
```

## smartscore_wt99_p4/components/board_wt99/Kconfig
```kconfig
menu "WT99P4C5-S1 board network adaptation"

config SMARTSCORE_WT99_BOARD_REV_1V1
    bool "WT99P4C5-S1 revision 1V1"
    default y
    depends on IDF_TARGET_ESP32P4
    help
        Select the pin map documented by SCH_WT99P4C5-S1-1V1 sheet 2 and the
        Wireless-Tag official WT99P4C5-S1 example: SDIO slot 1, 4-bit,
        40 MHz, GPIO 14-19, and ESP32-C5 enable/reset on GPIO 54.

endmenu
```

## smartscore_wt99_p4/components/speaker_service/Kconfig
```kconfig
menu "SmartScore speaker service"

config SMARTSCORE_SPEAKER_ENABLED
    bool "Enable the onboard ES8311 speaker service"
    default y
    help
        Enable the WT99 ES8311, I2S output and NS4150B amplifier service.
        Disable only for a deliberately silent diagnostic build.

config SMARTSCORE_SPEAKER_STARTUP_TEST
    bool "Play a low-volume 440 Hz tone after speaker initialization"
    depends on SMARTSCORE_SPEAKER_ENABLED
    default n
    help
        Engineering-only startup check. Keep disabled for normal firmware so
        the external speaker never makes an unexpected sound at power-on.

endmenu
```

## smartscore_wt99_p4/components/voice_assistant/Kconfig
```kconfig
menu "Qwen Audio Realtime voice assistant"

    config SMARTSCORE_QWEN_AUDIO_REALTIME_ASSISTANT
        bool "Enable Qwen-Audio-Realtime-Plus voice assistant"
        default y
        depends on SMARTSCORE_SPEAKER_ENABLED

    config SMARTSCORE_QWEN_AUDIO_REALTIME_ENDPOINT
        string "WebSocket endpoint"
        default "wss://dashscope.aliyuncs.com/api-ws/v1/realtime?model=qwen-audio-3.0-realtime-plus"
        depends on SMARTSCORE_QWEN_AUDIO_REALTIME_ASSISTANT

    config SMARTSCORE_QWEN_AUDIO_REALTIME_VOICE
        string "Output voice"
        default "longanqian"
        depends on SMARTSCORE_QWEN_AUDIO_REALTIME_ASSISTANT

    config SMARTSCORE_QWEN_AUDIO_REALTIME_INSTRUCTIONS
        string "System instructions"
        default "You are the SmartScore piano voice assistant. Answer naturally and concisely in Chinese. The phrase 你好小智 is only a wake phrase and is not the user's question."
        depends on SMARTSCORE_QWEN_AUDIO_REALTIME_ASSISTANT

    config SMARTSCORE_QWEN_AUDIO_REALTIME_RECONNECT_MS
        int "WebSocket reconnect delay (milliseconds)"
        range 1000 30000
        default 3000
        depends on SMARTSCORE_QWEN_AUDIO_REALTIME_ASSISTANT

endmenu
```

## smartscore_wt99_p4/main/Kconfig.projbuild
```kconfig
menu "SmartScore WT99 stage-one network firmware"

config SMARTSCORE_NETWORK_ONLY
    bool "Build only the stage-one network firmware"
    default y

config SMARTSCORE_WEB_PROVISIONING_FALLBACK
    bool "Enable SmartScore_Setup web provisioning fallback"
    default n
    help
        BLE is the primary provisioning path. Enable this only when the
        SmartScore_Setup SoftAP fallback is required.

config SMARTSCORE_WIFI_MAX_RETRIES
    int "Maximum Wi-Fi connection attempts"
    range 1 10
    default 5

config SMARTSCORE_WIFI_ATTEMPT_TIMEOUT_SECONDS
    int "Timeout for each Wi-Fi attempt"
    range 3 60
    default 12

config SMARTSCORE_AUTO_CONNECT_SAVED_WIFI
    bool "Automatically connect saved Wi-Fi at startup"
    default y
    help
        When enabled, startup loads valid credentials from smartscore_net
        and tries the saved network with the separate bounded startup policy.
        BLE provisioning remains available when no credentials are saved or
        the bounded connection attempt fails.

config SMARTSCORE_SAVED_WIFI_MAX_ATTEMPTS
    int "Maximum saved Wi-Fi connection attempts at startup"
    range 1 20
    default 10
    help
        Caps how many times startup may trigger a connection to the saved
        network. The total startup timeout can end this loop earlier.

config SMARTSCORE_SAVED_WIFI_TOTAL_TIMEOUT_SECONDS
    int "Total saved Wi-Fi startup timeout"
    range 1 30
    default 5
    help
        Hard time budget for all saved-network connection attempts at boot.
        This does not change the timeout used after BLE or web provisioning.

endmenu
```
